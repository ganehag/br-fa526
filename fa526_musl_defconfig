## fa526_musl_defconfig
```kconfig
#
# CPU
#
BR2_arm=y
BR2_fa526=y

#
# LibC
#
BR2_TOOLCHAIN_BUILDROOT_LIBC="musl"
BR2_TOOLCHAIN_USES_MUSL=y
BR2_TOOLCHAIN_BUILDROOT_MUSL=y
BR2_PACKAGE_MUSL=y
BR2_PACKAGE_MUSL_COMPAT_HEADERS=y

#
# GCC
#
BR2_GCC_VERSION_4_9_X=y
BR2_GCC_VERSION="4.9.4"
BR2_TOOLCHAIN_GCC_AT_LEAST_4_9=y
BR2_TOOLCHAIN_GCC_AT_LEAST="4.9"
```

## fa526_uclibc_defconfig
```kconfig
#
# CPU
#
BR2_arm=y
BR2_fa526=y

#
# GCC
#
BR2_GCC_VERSION_4_9_X=y
BR2_GCC_VERSION="4.9.4"
BR2_TOOLCHAIN_GCC_AT_LEAST_4_9=y
BR2_TOOLCHAIN_GCC_AT_LEAST="4.9"
```

## musl/ts7500_defconfig
```kconfig
#
# CPU
#
BR2_arm=y
BR2_fa526=y

#
# LibC
#
BR2_TOOLCHAIN_BUILDROOT_LIBC="musl"
BR2_TOOLCHAIN_USES_MUSL=y
BR2_TOOLCHAIN_BUILDROOT_MUSL=y
BR2_PACKAGE_MUSL=y
BR2_PACKAGE_MUSL_COMPAT_HEADERS=y
```
